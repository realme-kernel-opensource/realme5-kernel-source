## drivers/input/RM/Kconfig
```kconfig
#
# WT ODM RM device configuration
#

menu "ODM_RM_device"

config ODM_RM
	bool "WT ODM RM device"
	help
	  Say Y here if this project want device info.
	  If unsure, say N.
config ODM_RM_DEVICEINFO
	depends on ODM_RM
	bool "WT ODM RM deviceinfo"
	help
	  Say Y here if this project want device info.
	  If unsure, say N.
endmenu
```

## drivers/input/touchscreen/NT36525B/Kconfig
```kconfig
#*******************************************************************************
# Copyright (C), 2008-2016, OPPO Mobile Comm Corp., Ltd.
# ODM_WT_EDIT
# FILE: - Kconfig
# Description : Novatek NT36525B touchscreen driver configuration
# Version: 1.0
# Date : 2019/06/25
# Author: subin@ODM_WT.BSP.TP-FP.TP
#
# -------------------------Revision History:----------------------------------
#  <author>	 <data> 	<version >			<desc>
#
#
#*******************************************************************************/
config TOUCHSCREEN_NT36525B
	bool "Novatek NT36525B host download SPI driver"
	help
	  Say Y here if you have a Novatek NT36525B no flash touchscreen connected
	  to your system by SPI bus.

	  If unsure, say N.
```

## drivers/wt_sys/Kconfig
```kconfig
#/*************************************************************************
# * ** Copyright (C), 2008-2016, OPPO Mobile Comm Corp., Ltd.
# * ** ODM_WT_EDIT
# * ** File: - Kconfig
# * ** Description: Add for bootloader log
# * ** Version: 1.0
# * ** Date : 2019/04/20
# * ** Author: Hui.Wang@ODM_WT.BSP.Kernel.Stability
# * **
# * ** ------------------- Revision History: -------------------------------
# * **    <author>       <data>         <version >      <desc>
# * **    Hui.Wang       2019/04/20     1.0             build this module
# * **********************************************************************/

config WT_SYSTEM
	tristate "CONFIG_WT_SYSTEM"
	default n

config WT_BOOTLOADER_LOG
	tristate "CONFIG_WT_BOOTLOADER_LOG"
	default n

config WT_BOOT_REASON
	tristate "CONFIG_WT_BOOT_REASON"
	default n
```
