/***********************************************************
** Copyright (C), 2008-2016, OPPO Mobile Comm Corp., Ltd.
** ODM_WT_EDIT
** File: - dsi-panel-nt36525b-hlt-boe-singlemipi-hdp-video.dtsi
** Description: source nt36525b hlt boe panel config in kernel
**
** Version: 1.0
** Date : 2019/06/17
** Author: Hongzhu.Su@ODM_WT.MM.Display.LCD
**
** ------------------------------- Revision History: -------------------------------
**  	<author>		<data> 	   <version >	       <desc>
**  Hongzhu.Su@ODM_WT      2019/06/17    1.0     source  nt36525b hlt boe panel config in kernel
**
****************************************************************/
&mdss_mdp {
	dsi_nt36525b_hlt_boe_video: qcom,mdss_dsi_nt36525b_hlt_boe_video {
		qcom,mdss-dsi-panel-name =
			"nt36525b hdp video hlt boe panel";
		qcom,mdss-dsi-panel-type = "dsi_video_mode";

		qcom,mdss-dsi-virtual-channel-id = <0>;
		qcom,mdss-dsi-stream = <0>;
		qcom,mdss-dsi-h-left-border = <0>;
		qcom,mdss-dsi-h-right-border = <0>;
		qcom,mdss-dsi-v-top-border = <0>;
		qcom,mdss-dsi-v-bottom-border = <0>;
		qcom,mdss-dsi-bpp = <24>;
		qcom,mdss-dsi-color-order = "rgb_swap_rgb";
		qcom,mdss-dsi-underflow-color = <0xff>;
		qcom,mdss-dsi-border-color = <0>;
		qcom,mdss-dsi-h-sync-pulse = <0>;
		qcom,mdss-dsi-traffic-mode = "non_burst_sync_event";
		qcom,mdss-dsi-lane-map = "lane_map_012";
		qcom,mdss-dsi-bllp-eof-power-mode;
		qcom,mdss-dsi-bllp-power-mode;
		qcom,mdss-dsi-tx-eot-append;
		qcom,mdss-dsi-lane-0-state;
		qcom,mdss-dsi-lane-1-state;
		qcom,mdss-dsi-lane-2-state;
		qcom,mdss-dsi-dma-trigger = "trigger_sw";
		qcom,mdss-dsi-mdp-trigger = "none";
		//qcom,mdss-dsi-lp11-init;//Hongzhu.Su@ODM_WT.MM.Display.Lcd.1941873,2019/08/12, Adjust lcd power on/off sequence for nt36525b
		qcom,mdss-dsi-novatek-flag;
		qcom,mdss-dsi-bl-pmic-control-type = "bl_ctrl_dcs";
		qcom,mdss-dsi-bl-min-level = <1>;
		qcom,mdss-dsi-bl-max-level = <2047>;
		qcom,mdss-brightness-max-level = <2047>;
		qcom,mdss-dsi-reset-sequence = <1 5>, <0 5>, <1 5>;
		qcom,mdss-pan-physical-width-dimension = <68>;
		qcom,mdss-pan-physical-height-dimension = <151>;

				qcom,blmap-size = <128>;
				qcom,blmap = <
			            36 6
				    16 11
				    17 12
				    19 13
				    19 15
				    20 14
				    22 14
				    22 14
				    24 10
				    24 8
				    26 4
				    27 0
				    29 9
				    29 9
				    30 14
				    33 25
				    34 30
				    36 44
				    37 49
				    40 65
				    40 69
				    43 88
				    46 109
				    47 112
				    50 135
				    53 161
				    53 163
				    60 220
				    60 223
				    64 257
				    63 255
				    71 334
				    71 331
				    75 375
				    80 422
				    84 473
				    89 529
				    88 518
				    99 653
				    98 640
				    103 707
				    117 878
				    115 862
				    122 947
				    128 1039
				    135 1138
				    132 1102
				    149 1355
				    157 1478
				    166 1611
				    163 1563
				    183 1900
				    180 1844
				    203 2232
				    199 2169
				    209 2344
				    236 2821
				    232 2742
				    243 2958
				    255 3188
				    268 3433
				    282 3705
				    317 4400
				    176 1555>;

		qcom,esd-check-enabled;
		qcom,mdss-dsi-panel-status-command = [06 01 00 01 00 00 01 0a];
		qcom,mdss-dsi-panel-status-command-state = "dsi_lp_mode";
		qcom,mdss-dsi-panel-status-read-length = <1>;
		qcom,mdss-dsi-panel-status-value = <0x9C>;
		qcom,mdss-dsi-panel-status-check-mode = "reg_read";

		qcom,mdss-dsi-display-timings {
			timing@0 {
				qcom,mdss-dsi-panel-width = <720>;
				qcom,mdss-dsi-panel-height = <1600>;
				qcom,mdss-dsi-h-front-porch = <36>;
				qcom,mdss-dsi-h-back-porch = <44>;
				qcom,mdss-dsi-h-pulse-width = <4>;
				qcom,mdss-dsi-h-sync-skew = <0>;
				qcom,mdss-dsi-v-back-porch = <254>;
				qcom,mdss-dsi-v-front-porch = <10>;
				qcom,mdss-dsi-v-pulse-width = <2>;
				qcom,mdss-dsi-panel-framerate = <60>;
				qcom,mdss-dsi-on-command = [
				  39 01 00 00 01 00 02 FF 23
				  39 01 00 00 00 00 02 FB 01
				  39 01 00 00 00 00 02 00 68
				  39 01 00 00 00 00 02 07 00
				  39 01 00 00 00 00 02 08 01
				  39 01 00 00 00 00 02 10 3A
				  39 01 00 00 00 00 02 11 00
				  39 01 00 00 00 00 02 12 AB
				  39 01 00 00 00 00 02 15 EB
				  39 01 00 00 00 00 02 16 0B
				  39 01 00 00 00 00 02 29 20
				  39 01 00 00 00 00 02 2A 20
				  39 01 00 00 00 00 02 2B 20
				  39 01 00 00 00 00 02 30 FF
				  39 01 00 00 00 00 02 31 FD
				  39 01 00 00 00 00 02 32 FA
				  39 01 00 00 00 00 02 33 F7
				  39 01 00 00 00 00 02 34 F4
				  39 01 00 00 00 00 02 35 F0
				  39 01 00 00 00 00 02 36 ED
				  39 01 00 00 00 00 02 37 EC
				  39 01 00 00 00 00 02 38 EB
				  39 01 00 00 00 00 02 39 EA
				  39 01 00 00 00 00 02 3A E9
				  39 01 00 00 00 00 02 3B E8
				  39 01 00 00 00 00 02 3D E7
				  39 01 00 00 00 00 02 3F E6
				  39 01 00 00 00 00 02 40 E5
				  39 01 00 00 00 00 02 41 E4
				  39 01 00 00 00 00 02 45 FF
				  39 01 00 00 00 00 02 46 FA
				  39 01 00 00 00 00 02 47 F2
				  39 01 00 00 00 00 02 48 E8
				  39 01 00 00 00 00 02 49 E4
				  39 01 00 00 00 00 02 4A DC
				  39 01 00 00 00 00 02 4B D7
				  39 01 00 00 00 00 02 4C D5
				  39 01 00 00 00 00 02 4D D3
				  39 01 00 00 00 00 02 4E D2
				  39 01 00 00 00 00 02 4F D0
				  39 01 00 00 00 00 02 50 CE
				  39 01 00 00 00 00 02 51 CD
				  39 01 00 00 00 00 02 52 CB
				  39 01 00 00 00 00 02 53 C6
				  39 01 00 00 00 00 02 54 C3
				  39 01 00 00 01 00 02 FF 10
				  39 01 00 00 00 00 02 FB 01
				  39 01 00 00 00 00 03 68 04 01
				  39 01 00 00 00 00 02 53 24
				  39 01 00 00 00 00 02 35 00
				  05 01 00 00 00 00 01 29
				  05 01 00 00 64 00 01 11];
				qcom,mdss-dsi-off-command = [
				  05 01 00 00 14 00 02 28 00
				  05 01 00 00 78 00 02 10 00];
				qcom,mdss-dsi-on-command-state = "dsi_lp_mode";
				qcom,mdss-dsi-off-command-state = "dsi_hs_mode";
			};
		};
	};
};
